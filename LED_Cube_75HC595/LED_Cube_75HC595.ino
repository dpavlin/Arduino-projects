#include <avr/pgmspace.h> // allows use of PROGMEM to store patterns in flash

#define CUBESIZE 4
#define PLANESIZE CUBESIZE*CUBESIZE
#define PLANETIME 3333 // time each plane is displayed in us -> 100 Hz refresh
#define TIMECONST 20 // multiplies DisplayTime to get ms - why not =100?

// LED Pattern Table in PROGMEM - last column is display time in 100ms units
// TODO this could be a lot more compact but not with binary pattern representation
const uint8_t PROGMEM PatternTable[] = {
// blink on and off

B0001,B0000,B0000,B0000,B0001,B0000,B0000,B0000,B0000,B0000,B0000,B0000,B0000,B0000,B0000,B0000,10,
B0011,B0000,B0000,B0000,B0011,B0000,B0000,B0000,B0000,B0000,B0000,B0000,B0000,B0000,B0000,B0000,10,
B0011,B0010,B0000,B0000,B0011,B0010,B0000,B0000,B0000,B0000,B0000,B0000,B0000,B0000,B0000,B0000,10,
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B0000,B0000,B0000,B0000,B0000,B0000,B0000,B0000,B0000,B0000,B0000,B0000,B0000,B0000,B0000,B0000,10,


// this is a dummy element for end of table (duration=0) aka !!!DO NOT TOUCH!!!
B0000,B0000,B0000,B0000,B0000,B0000,B0000,B0000,B0000,B0000,B0000,B0000,B0000,B0000,B0000,B0000,0
};

//int LEDPin[] = {13, 12, 11, 10, 9, 8, 7, 6, 5, 4, 3, 2, 1, 0, 14, 15};

int clockPin = 0;
int latchPin = 1;
int enablePin = 2;
int dataPin = 3;

int PlanePin[] = {4, 5, 6, 7};

// initialization
void setup()
{
	int pin; // loop counter
	for (pin=0; pin<8; pin++) {
		pinMode( pin, OUTPUT );
	}
}

// display pattern in table until DisplayTime is zero (then repeat)
void loop()
{
// declare variables
byte PatternBuf[PLANESIZE]; // saves current pattern from PatternTable
int PatternIdx;
byte DisplayTime; // time*100ms to display pattern
unsigned long EndTime;
int plane; // loop counter for cube refresh
int patbufidx; // indexes which byte from pattern buffer
int ledrow; // counts LEDs in refresh loop
int ledcol; // counts LEDs in refresh loop
int ledpin; // counts LEDs in refresh loop
int pinState;

// Initialize PatternIdx to beginning of pattern table
PatternIdx = 0;
// loop over entries in pattern table - while DisplayTime>0
do {
	// read pattern from PROGMEM and save in array
	memcpy_P( PatternBuf, PatternTable+PatternIdx, PLANESIZE );
	PatternIdx += PLANESIZE;
	// read DisplayTime from PROGMEM and increment index
	DisplayTime = pgm_read_byte_near( PatternTable + PatternIdx++ );
	// compute EndTime from current time (ms) and DisplayTime
	EndTime = millis() + ((unsigned long) DisplayTime) * TIMECONST;

	// loop while DisplayTime>0 and current time < EndTime
	while ( millis() < EndTime ) {
		patbufidx = 0; // reset index counter to beginning of buffer
		// loop over planes
		for (plane=0; plane<CUBESIZE; plane++) {
			// turn previous plane off
			if (plane==0) {
				digitalWrite( PlanePin[CUBESIZE-1], HIGH );
			} else {
				digitalWrite( PlanePin[plane-1], HIGH );
			}

			digitalWrite( latchPin, LOW );
			digitalWrite( enablePin, HIGH );

			// load current plane pattern data into ports
			ledpin = 0;
			for (ledrow=0; ledrow<CUBESIZE; ledrow++) {
				for (ledcol=0; ledcol<CUBESIZE; ledcol++) {
					digitalWrite( clockPin, LOW );
					if (PatternBuf[patbufidx] & (1 << ledcol)) {
						pinState= 1;  // Flip these bits to suit your cubes common lead (cathode or anode)
					} else {
						pinState= 0;  // Flip these bits to suit your cubes common lead (cathode or anode)
					}

					//Sets the pin to HIGH or LOW depending on pinState
					digitalWrite(dataPin, pinState); // this is where data is sent to the shift register.
					//register shifts bits on upstroke of clock pin
					digitalWrite(clockPin, HIGH);
				}
				patbufidx++;
			}

			digitalWrite( latchPin, HIGH );
			digitalWrite( enablePin, LOW );

			// turn current plane on
			digitalWrite( PlanePin[plane], LOW );
			// delay PLANETIME us
			delayMicroseconds( PLANETIME );
		} // for plane
	} // while <EndTime
} while (DisplayTime > 0); // read patterns until time=0 which signals end
}
